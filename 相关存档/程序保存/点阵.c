#include <reg52.h>
#include "atime_spi_3.h"
#include "atime_lcd1602.h"

unsigned char code lie[]={0xfe,0xfd,0xfb,0xf7,0xef,0xdf,0xbf,0x7f}; 
unsigned char code hang[10][8]={   //字模取模方式 阴码 逆向 逐列式
{0x00,0x00,0x3E,0x41,0x41,0x3E,0x00,0x00},/*"0",0*/

{0x00,0x00,0x42,0x7F,0x40,0x00,0x00,0x00},/*"1",1*/
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{0x00,0x00,0x26,0x49,0x49,0x3E,0x00,0x00},/*"9",9*/
};

void main()
{
	unsigned int i=8,j=0,k=0;
	while(1)
	{
		spi_writeachar(lie[i]);
		spi_writeachar(hang[j][i]);
		SPI_SS =0;
		SPI_SS =1;	
		i--;
		if(i==0)
			i =8;
		k++;
		if(k==6550)
		{
			k =0;
			j++;
			if(j==10)
				j =0;
		}
	}	
}