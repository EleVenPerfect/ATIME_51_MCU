#include <reg52.h>
#include "atime_spi2.h"
#include "atime_spi_sdcard.h"

unsigned char xdata buff[512]={
0,1,2,3,4,5,6,7,8,9,0,1,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9,
0,1,2,3,4,5,6,7,8,9,0,1,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9,
0,1,2,3,4,5,6,7,8,9,0,1,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9,
0,1,2,3,4,5,6,7,8,9,0,1,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9,
0,1,2,3,4,5,6,7,8,9,0,1,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9,
1
};

void serial_int(void)
{
	PCON &= 0x7f;	//波特率不倍速
	SCON = 0x50;	//8位数据,可变波特率
	TMOD &= 0x0f;	//清除定时器1模式位
	TMOD |= 0x20;	//设定定时器1为8位自动重装方式
	TL1 = 0xFD;		//设定定时初值
	TH1 = 0xFD;		//设定定时器重装值
	ET1 = 0;		//禁止定时器1中断
	TR1 = 1;		//启动定时器1
}


void send_char(unsigned char dat)
{
   SBUF=dat;
   while(!TI);
   TI=0;
}

void main(void)
{
	unsigned int i;

	serial_int();
	for(i=0;i<100; i++);
	P0 =0X0F;
	sd_res();
	P0 =0X87;

	P0 =0XC3;
	sd_write512(3,buff);
	P0 =0XE1;
	

	sd_read512(3,buff);
	P0 =0X0F;

	for(i=0; i<512; i++)
	{
		send_char(buff[i]);
		send_char(i);
	}
	P0 =0X00;
	while(1);
}