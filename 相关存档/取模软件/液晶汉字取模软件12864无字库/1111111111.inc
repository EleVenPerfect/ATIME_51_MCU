;*-------------------------------------------------------------------- *
;* Bitmap点阵数据表                                                    *
;* 图片: C:\..111111111.bmp,横向取模左高位,数据排列:从左到右从上到下   *
;* 图片尺寸: 64 * 64                                                   *
;*-------------------------------------------------------------------- *
nBitmapDot:                                   ; 数据表

	db  0FFh,0FFh,0FFh,0FFh,0FFh,0FFh,0F7h,0FFh,0FFh,0FFh,0FFh,0FFh,0FFh,0FFh,0FFh,0FFh
	db	0FFh,0FFh,0FFh,0FFh,0F7h,0FFh,0FFh,0FFh,0FFh,0FFh,0FFh,0FFh,0FFh,0FFh,0FFh,0FFh
	db	0FFh,0FFh,0FFh,0FFh,0FFh,0FFh,0FFh,0FFh,0FFh,0FFh,0FFh,0FFh,0FFh,0FFh,0FFh,0FFh
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	db	0FFh,0FFh,0FFh,0FFh,0FFh,0FFh,0FFh,0FFh,0FFh,0FFh,0FFh,0FFh,0FFh,0FFh,0FFh,0FFh
