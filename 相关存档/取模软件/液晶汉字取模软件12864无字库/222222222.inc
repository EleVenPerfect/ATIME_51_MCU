;*-------------------------------------------------------------------- *
;* Bitmap点阵数据表                                                    *
;* 图片: C:\..222222222.bmp,横向取模左高位,数据排列:从左到右从上到下   *
;* 图片尺寸: 64 * 64                                                   *
;*-------------------------------------------------------------------- *
nBitmapDot:                                   ; 数据表

	db   00h, 00h, 00h, 00h, 00h, 00h, 00h, 00h, 00h, 00h, 00h, 00h, 00h, 00h, 00h, 00h
	db	 00h, 00h, 00h, 00h, 00h, 00h, 00h, 00h, 00h, 00h, 00h, 00h, 00h, 00h, 00h, 00h
	db	 00h, 00h, 00h, 00h, 00h, 00h, 00h, 00h, 00h, 00h, 00h, 00h, 00h, 00h, 00h, 00h
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	db	 00h, 00h, 00h, 00h, 00h, 00h, 00h, 00h, 00h, 00h, 00h, 00h, 00h, 00h, 00h, 00h
